## Documentation/devicetree/bindings/input/touchscreen/novatek,nt36523n-ts.yaml
```yaml
# SPDX-License-Identifier: (GPL-2.0-only OR BSD-2-Clause)
%YAML 1.2
---
$id: http://devicetree.org/schemas/input/touchscreen/novatek,nt36523n-ts.yaml#
$schema: http://devicetree.org/meta-schemas/core.yaml#

title: Novatek NT36523N SPI touchscreen controller

maintainers:
  - lolipuru <banstellazz@gmail.com>

description:
  The touch controller of the Novatek NT36523N touch and display driver IC
  (TDDI). Touch and display share the chip, so the touch side has no reset or
  supplies of its own; it is powered and reset together with the display
  panel it follows.

allOf:
  - $ref: touchscreen.yaml#
  - $ref: /schemas/spi/spi-peripheral-props.yaml#

properties:
  compatible:
    const: novatek,nt36523n-ts

  reg:
    maxItems: 1

  interrupts:
    maxItems: 1

  panel:
    $ref: /schemas/types.yaml#/definitions/phandle
    description:
      The display panel driven by the same NT36523N. The touchscreen is
      brought up after the panel is powered on.

  firmware-name:
    maxItems: 1

  novatek,pen-support:
    type: boolean
    description: The panel has an active pen digitiser.

required:
  - compatible
  - reg
  - interrupts
  - panel

unevaluatedProperties: false

examples:
  - |
    #include <dt-bindings/interrupt-controller/irq.h>

    spi {
        #address-cells = <1>;
        #size-cells = <0>;

        touchscreen@0 {
            compatible = "novatek,nt36523n-ts";
            reg = <0>;
            spi-max-frequency = <9600000>;
            interrupts-extended = <&tlmm 21 IRQ_TYPE_EDGE_RISING>;
            panel = <&display_panel>;
            firmware-name = "novatek/novatek_ts_fw.bin";
            touchscreen-size-x = <1600>;
            touchscreen-size-y = <2560>;
            novatek,pen-support;
        };
    };
...
```

## Documentation/devicetree/bindings/media/i2c/ovti,ov13b10.yaml
```yaml
# SPDX-License-Identifier: (GPL-2.0-only OR BSD-2-Clause)
%YAML 1.2
---
$id: http://devicetree.org/schemas/media/i2c/ovti,ov13b10.yaml#
$schema: http://devicetree.org/meta-schemas/core.yaml#

title: OmniVision OV13B10 13MP CMOS Image Sensor

maintainers:
  - lolipuru <banstellazz@gmail.com>

description:
  The OmniVision OV13B10 is a 13 megapixel RAW Bayer image sensor with a
  MIPI CSI-2 interface of up to four data lanes, controlled over I2C (SCCB).

allOf:
  - $ref: /schemas/media/video-interface-devices.yaml#

properties:
  compatible:
    const: ovti,ov13b10

  reg:
    maxItems: 1

  clocks:
    maxItems: 1

  power-domains:
    maxItems: 1

  avdd-supply:
    description: Analogue circuit voltage supply.

  dovdd-supply:
    description: I/O circuit voltage supply.

  dvdd-supply:
    description: Digital circuit voltage supply.

  reset-gpios:
    description: Active low GPIO connected to the XSHUTDOWN pin of the sensor.
    maxItems: 1

  port:
    $ref: /schemas/graph.yaml#/$defs/port-base
    additionalProperties: false

    properties:
      endpoint:
        $ref: /schemas/media/video-interfaces.yaml#
        unevaluatedProperties: false

        properties:
          data-lanes:
            description: Two or four MIPI CSI-2 data lanes.
            oneOf:
              - items:
                  - const: 1
                  - const: 2
              - items:
                  - const: 1
                  - const: 2
                  - const: 3
                  - const: 4
          link-frequencies: true

        required:
          - data-lanes
          - link-frequencies

required:
  - compatible
  - reg
  - clocks
  - port

unevaluatedProperties: false

examples:
  - |
    #include <dt-bindings/gpio/gpio.h>

    i2c {
        #address-cells = <1>;
        #size-cells = <0>;

        camera@36 {
            compatible = "ovti,ov13b10";
            reg = <0x36>;

            clocks = <&cam_mclk>;
            assigned-clocks = <&cam_mclk>;
            assigned-clock-rates = <24000000>;

            reset-gpios = <&tlmm 25 GPIO_ACTIVE_LOW>;

            avdd-supply = <&vreg_cam_avdd>;
            dovdd-supply = <&vreg_cam_dovdd>;
            dvdd-supply = <&vreg_cam_dvdd>;

            orientation = <1>;
            rotation = <270>;

            port {
                ov13b10_ep: endpoint {
                    data-lanes = <1 2 3 4>;
                    link-frequencies = /bits/ 64 <560000000>;
                    remote-endpoint = <&csiphy_ep>;
                };
            };
        };
    };
...
```

## Documentation/devicetree/bindings/media/i2c/samsung,s5k4h7.yaml
```yaml
# SPDX-License-Identifier: (GPL-2.0-only OR BSD-2-Clause)
%YAML 1.2
---
$id: http://devicetree.org/schemas/media/i2c/samsung,s5k4h7.yaml#
$schema: http://devicetree.org/meta-schemas/core.yaml#

title: Samsung S5K4H7 8MP CMOS Image Sensor

maintainers:
  - lolipuru <banstellazz@gmail.com>

description:
  The Samsung S5K4H7 is an 8 megapixel RAW Bayer image sensor with a
  four-lane MIPI CSI-2 interface, controlled over I2C.

allOf:
  - $ref: /schemas/media/video-interface-devices.yaml#

properties:
  compatible:
    const: samsung,s5k4h7

  reg:
    maxItems: 1

  clocks:
    maxItems: 1

  power-domains:
    maxItems: 1

  avdd-supply:
    description: Analogue circuit voltage supply.

  dovdd-supply:
    description: I/O circuit voltage supply.

  dvdd-supply:
    description: Digital circuit voltage supply.

  reset-gpios:
    description: Active low GPIO connected to the XSHUTDOWN pin of the sensor.
    maxItems: 1

  port:
    $ref: /schemas/graph.yaml#/$defs/port-base
    additionalProperties: false

    properties:
      endpoint:
        $ref: /schemas/media/video-interfaces.yaml#
        unevaluatedProperties: false

        properties:
          data-lanes:
            description: Four MIPI CSI-2 data lanes.
            items:
              - const: 1
              - const: 2
              - const: 3
              - const: 4
          link-frequencies: true

        required:
          - data-lanes
          - link-frequencies

required:
  - compatible
  - reg
  - clocks
  - port

unevaluatedProperties: false

examples:
  - |
    #include <dt-bindings/gpio/gpio.h>

    i2c {
        #address-cells = <1>;
        #size-cells = <0>;

        camera@10 {
            compatible = "samsung,s5k4h7";
            reg = <0x10>;

            clocks = <&cam_mclk>;
            assigned-clocks = <&cam_mclk>;
            assigned-clock-rates = <24000000>;

            reset-gpios = <&tlmm 25 GPIO_ACTIVE_LOW>;

            avdd-supply = <&vreg_cam_avdd>;
            dovdd-supply = <&vreg_cam_dovdd>;
            dvdd-supply = <&vreg_cam_dvdd>;

            orientation = <1>;
            rotation = <270>;

            port {
                s5k4h7_ep: endpoint {
                    data-lanes = <1 2 3 4>;
                    link-frequencies = /bits/ 64 <340000000>;
                    remote-endpoint = <&csiphy_ep>;
                };
            };
        };
    };
...
```

## Documentation/devicetree/bindings/media/i2c/smartsens,sc202cs.yaml
```yaml
# SPDX-License-Identifier: (GPL-2.0-only OR BSD-2-Clause)
%YAML 1.2
---
$id: http://devicetree.org/schemas/media/i2c/smartsens,sc202cs.yaml#
$schema: http://devicetree.org/meta-schemas/core.yaml#

title: SmartSens SC202CS 2MP CMOS Image Sensor

maintainers:
  - lolipuru <banstellazz@gmail.com>

description:
  The SmartSens SC202CS is a 2 megapixel RAW Bayer image sensor with a
  single-lane MIPI CSI-2 interface, controlled over I2C.

allOf:
  - $ref: /schemas/media/video-interface-devices.yaml#

properties:
  compatible:
    const: smartsens,sc202cs

  reg:
    maxItems: 1

  clocks:
    maxItems: 1

  power-domains:
    maxItems: 1

  avdd-supply:
    description: Analogue circuit voltage supply.

  dovdd-supply:
    description: I/O circuit voltage supply.

  dvdd-supply:
    description: Digital circuit voltage supply.

  reset-gpios:
    description: Active low GPIO connected to the XSHUTDOWN pin of the sensor.
    maxItems: 1

  port:
    $ref: /schemas/graph.yaml#/$defs/port-base
    additionalProperties: false

    properties:
      endpoint:
        $ref: /schemas/media/video-interfaces.yaml#
        unevaluatedProperties: false

        properties:
          data-lanes:
            description: One MIPI CSI-2 data lane.
            items:
              - const: 1
          link-frequencies: true

        required:
          - data-lanes
          - link-frequencies

required:
  - compatible
  - reg
  - clocks
  - port

unevaluatedProperties: false

examples:
  - |
    #include <dt-bindings/gpio/gpio.h>

    i2c {
        #address-cells = <1>;
        #size-cells = <0>;

        camera@36 {
            compatible = "smartsens,sc202cs";
            reg = <0x36>;

            clocks = <&cam_mclk>;
            assigned-clocks = <&cam_mclk>;
            assigned-clock-rates = <24000000>;

            reset-gpios = <&tlmm 25 GPIO_ACTIVE_LOW>;

            avdd-supply = <&vreg_cam_avdd>;
            dovdd-supply = <&vreg_cam_dovdd>;
            dvdd-supply = <&vreg_cam_dvdd>;

            orientation = <1>;
            rotation = <270>;

            port {
                sc202cs_ep: endpoint {
                    data-lanes = <1>;
                    link-frequencies = /bits/ 64 <336000000 207000000>;
                    remote-endpoint = <&csiphy_ep>;
                };
            };
        };
    };
...
```

## Documentation/devicetree/bindings/regulator/willsemi,wl2864c.yaml
```yaml
# SPDX-License-Identifier: (GPL-2.0-only OR BSD-2-Clause)
%YAML 1.2
---
$id: http://devicetree.org/schemas/regulator/willsemi,wl2864c.yaml#
$schema: http://devicetree.org/meta-schemas/core.yaml#

title: Will Semiconductor WL2864C camera PMIC

maintainers:
  - lolipuru <banstellazz@gmail.com>

description:
  The WL2864C is an I2C controlled power management IC with seven LDOs,
  typically used to supply camera sensors and lens actuators. LDO1 and LDO2
  are low voltage outputs fed from vin1, LDO3 to LDO7 are fed from vin2.

properties:
  compatible:
    const: willsemi,wl2864c

  reg:
    maxItems: 1

  vddio-supply:
    description: Supply of the I2C interface and control logic.

  vin1-supply:
    description: Input supply of LDO1 and LDO2.

  vin2-supply:
    description: Input supply of LDO3 to LDO7.

  regulators:
    type: object
    additionalProperties: false

    patternProperties:
      "^ldo[1-7]$":
        type: object
        $ref: regulator.yaml#
        unevaluatedProperties: false

required:
  - compatible
  - reg
  - vddio-supply
  - regulators

additionalProperties: false

examples:
  - |
    i2c {
        #address-cells = <1>;
        #size-cells = <0>;

        pmic@29 {
            compatible = "willsemi,wl2864c";
            reg = <0x29>;
            vddio-supply = <&vreg_io>;
            vin1-supply = <&vreg_1p8>;
            vin2-supply = <&vreg_bob>;

            regulators {
                ldo1 {
                    regulator-name = "cam_dvdd";
                    regulator-min-microvolt = <1100000>;
                    regulator-max-microvolt = <1100000>;
                };

                ldo4 {
                    regulator-name = "cam_avdd";
                    regulator-min-microvolt = <2800000>;
                    regulator-max-microvolt = <2800000>;
                };
            };
        };
    };
```
